INCLUDE "platform/section_default_text.ld"
INCLUDE "platform/section_default_data.ld"
INCLUDE "rp2_common/section_heap.ld"
INCLUDE "rp2_common/section_scratch.ld"
INCLUDE "rp2_common/section_flash_end.ld"
INCLUDE "rp2_common/section_end.ld"
INCLUDE "platform/section_platform_end.ld"
