/* Use secure ram (copied from pico_set_security_ram_split):
    pico_set_linker_script_var(${SECURE_TARGET} RAM_ORIGIN "RAM_ORIGIN_DEFAULT")
    pico_set_linker_script_var(${SECURE_TARGET} RAM_LENGTH "${SECURE_LENGTH}-(${SECURE_SCRATCH_LENGTH}*2)")
    pico_set_linker_script_var(${SECURE_TARGET} SCRATCH_X_ORIGIN "RAM_ORIGIN+RAM_LENGTH")
    pico_set_linker_script_var(${SECURE_TARGET} SCRATCH_X_LENGTH ${SECURE_SCRATCH_LENGTH})
    pico_set_linker_script_var(${SECURE_TARGET} SCRATCH_Y_ORIGIN "SCRATCH_X_ORIGIN+SCRATCH_X_LENGTH")
    pico_set_linker_script_var(${SECURE_TARGET} SCRATCH_Y_LENGTH SCRATCH_X_LENGTH)
*/
SECURE_LENGTH = 64k;
SECURE_SCRATCH_LENGTH = 2k;

RAM_ORIGIN = RAM_ORIGIN_DEFAULT;
RAM_LENGTH = SECURE_LENGTH-(SECURE_SCRATCH_LENGTH*2);
SCRATCH_X_ORIGIN = RAM_ORIGIN+RAM_LENGTH;
SCRATCH_X_LENGTH = SECURE_SCRATCH_LENGTH;
SCRATCH_Y_ORIGIN = SCRATCH_X_ORIGIN+SCRATCH_X_LENGTH;
SCRATCH_Y_LENGTH = SCRATCH_X_LENGTH;

INCLUDE "memmap_no_flash.incl"
